## CMakeLists.txt
```
# SPDX-License-Identifier: Apache-2.0
cmake_minimum_required(VERSION 3.20.0)
find_package(Zephyr REQUIRED HINTS $ENV{ZEPHYR_BASE})

project(project_mobile_node)

target_include_directories(app PRIVATE include)

target_sources(app PRIVATE src/main.c src/nus_peripheral.c src/ble.c src/watchdog.c)
```

## prj.conf
```kconfig
# Bluetooth core
CONFIG_BT=y
CONFIG_BT_PERIPHERAL=y
CONFIG_BT_OBSERVER=y
CONFIG_BT_SMP=y
CONFIG_BT_MAX_CONN=1
CONFIG_BT_GATT_SERVICE_CHANGED=y
CONFIG_SETTINGS=y

# NUS peripheral
CONFIG_BT_ZEPHYR_NUS=y

# Device name — base node scans for this
CONFIG_BT_DEVICE_NAME="mobile_node"

# Data Length Extension and MTU
CONFIG_BT_USER_DATA_LEN_UPDATE=y
CONFIG_BT_CTLR_DATA_LENGTH_MAX=251
CONFIG_BT_BUF_ACL_RX_SIZE=251
CONFIG_BT_BUF_ACL_TX_SIZE=251
CONFIG_BT_L2CAP_TX_MTU=247

CONFIG_BT_BUF_CMD_TX_COUNT=10
CONFIG_BT_BUF_EVT_RX_COUNT=10
CONFIG_BT_CONN_TX_MAX=10

CONFIG_BT_RX_STACK_SIZE=2048

# Printing and logging
CONFIG_PRINTK=y
CONFIG_UART_CONSOLE=y
CONFIG_MAIN_STACK_SIZE=4096
CONFIG_SYSTEM_WORKQUEUE_STACK_SIZE=2048
CONFIG_LOG=y
CONFIG_LOG_DEFAULT_LEVEL=3
CONFIG_SHELL=y

CONFIG_WATCHDOG=y
```

## src/main.c
```c
#include <zephyr/kernel.h>
#include <zephyr/logging/log.h>

#include "nus_peripheral.h"
#include "watchdog.h"
#include "ble.h"

LOG_MODULE_REGISTER(main, LOG_LEVEL_INF);

#define WDT_FEED_STACK     512
#define WDT_FEED_PERIOD_MS 15000

K_THREAD_STACK_DEFINE(wdt_feed_stack, WDT_FEED_STACK);
static struct k_thread wdt_feed_thread_data;

static void wdt_feed_thread(void *p1, void *p2, void *p3)
{
    ARG_UNUSED(p1);
    ARG_UNUSED(p2);
    ARG_UNUSED(p3);

    while (1) {
        watchdog_feed();
        k_sleep(K_MSEC(WDT_FEED_PERIOD_MS));
    }
}

int main(void)
{
    watchdog_init();

    k_thread_create(&wdt_feed_thread_data, wdt_feed_stack,
                    WDT_FEED_STACK,
                    wdt_feed_thread, NULL, NULL, NULL,
                    7, 0, K_NO_WAIT);
    k_thread_name_set(&wdt_feed_thread_data, "wdt_feed");

    int err = nus_peripheral_init();
    if (err) {
        LOG_ERR("NUS peripheral init failed (err %d)", err);
        return err;
    }

    sniffer_start();


    return 0;
}
```

## include/ble.h
```c
#ifndef BLE_H
#define BLE_H

#include <stdint.h>
#include <zephyr/bluetooth/bluetooth.h>

void ble_broadcast_command(uint8_t cmd);
void sniffer_start(void);
void sniffer_device_found(const bt_addr_le_t *addr, int8_t rssi,
                           uint8_t type, struct net_buf_simple *ad);

#endif /* BLE_H */
```

## include/env_packet.h
```c
#ifndef ENV_PACKET_H
#define ENV_PACKET_H

#include <stdint.h>

#define ENV_NODE_NAME_LEN 9

struct env_record {
    char     node_id[ENV_NODE_NAME_LEN];  
    uint32_t timestamp_ms;                 
    int16_t  temp_centi_c;                
    uint16_t hum_centi_rh;                 
    uint16_t eco2_ppm;                     
    uint16_t tvoc_ppb;                    
};

#endif /* ENV_PACKET_H */
```

## include/nus_peripheral.h
```c
#ifndef NUS_PERIPHERAL_H
#define NUS_PERIPHERAL_H

#include <zephyr/bluetooth/conn.h>
#include <zephyr/kernel.h>
#include <stdbool.h>

extern struct bt_conn *current_conn;
extern bool nus_notify_enabled;
extern struct k_work_delayable adv_restart_work;

int nus_peripheral_init(void);

#endif /* NUS_PERIPHERAL_H */
```

## src/ble.c
```c
/*
 * Black-Valetudo - Mobile Node
 * General BLE implementation
 *
 * Threading model:
 * - BLE callback: pushes raw packets into msgq, returns immediately
 * - NUS send thread (high priority): sends node_records over NUS every SNIFF_WINDOW_MS
 * - Packet processing thread (lower priority): drains msgq, validates seq, updates node_records
 */

#include "ble.h"
#include "nus_peripheral.h"
#include "env_packet.h"

#include <zephyr/kernel.h>
#include <zephyr/logging/log.h>
#include <zephyr/bluetooth/bluetooth.h>
#include <zephyr/bluetooth/hci.h>
#include <zephyr/bluetooth/uuid.h>
#include <zephyr/bluetooth/services/nus.h>
#include <zephyr/sys/byteorder.h>
#include <string.h>

LOG_MODULE_REGISTER(ble, LOG_LEVEL_INF);

#define COMPANY_ID_DATA           0xFFFF
#define COMPANY_ID_CMD            0x0001
#define MFG_DATA_LEN              12

#define SNIFFER_MAX_NODES         8
#define SNIFF_WINDOW_MS           5000
#define NODE_TIMEOUT_MS           30000

#define CMD_BROADCAST_COUNT       3
#define CMD_BROADCAST_DURATION_MS 200
#define CMD_BROADCAST_GAP_MS      50

#define ADV_MSGQ_SIZE             32

#define NUS_SEND_THREAD_STACK     2048
#define NUS_SEND_THREAD_PRIORITY  3

#define PROC_THREAD_STACK         2048
#define PROC_THREAD_PRIORITY      5

#define EOW_NODE_ID "EOW"

extern struct bt_conn *current_conn;
extern bool nus_notify_enabled;
static struct env_record node_records[SNIFFER_MAX_NODES];
static uint8_t node_count = 0;
static struct k_mutex node_records_mutex;

struct raw_adv_record {
    char     node_id[ENV_NODE_NAME_LEN];
    uint8_t  seq;
    int16_t  temp_centi_c;
    uint16_t hum_centi_rh;
    uint16_t eco2_ppm;
    uint16_t tvoc_ppb;
    uint32_t timestamp_ms;
};

K_MSGQ_DEFINE(adv_msgq, sizeof(struct raw_adv_record), ADV_MSGQ_SIZE, 4);
K_MSGQ_DEFINE(cmd_msgq, sizeof(uint8_t), 4, 1);

struct node_seq_entry {
    char     node_id[ENV_NODE_NAME_LEN];
    uint8_t  last_seq;
    uint32_t last_seen_ms;
    bool     valid;
};

static struct node_seq_entry seq_table[SNIFFER_MAX_NODES];

static struct node_seq_entry *find_or_alloc_seq(const char *node_id)
{
    for (int i = 0; i < SNIFFER_MAX_NODES; i++) {
        if (seq_table[i].valid &&
            memcmp(seq_table[i].node_id, node_id, ENV_NODE_NAME_LEN) == 0) {
            return &seq_table[i];
        }
    }

    for (int i = 0; i < SNIFFER_MAX_NODES; i++) {
        if (!seq_table[i].valid) {
            memcpy(seq_table[i].node_id, node_id, ENV_NODE_NAME_LEN);
            seq_table[i].last_seq     = 0;
            seq_table[i].last_seen_ms = 0;
            seq_table[i].valid        = true;
            return &seq_table[i];
        }
    }

    return NULL;
}

static bool seq_is_valid(struct node_seq_entry *entry, uint8_t seq)
{
    uint32_t now = (uint32_t)k_uptime_get();

    if ((now - entry->last_seen_ms) > NODE_TIMEOUT_MS) {
        return true;
    }

    return seq > entry->last_seq;
}

static struct env_record *find_or_alloc_node(const char *name)
{
    for (int i = 0; i < node_count; i++) {
        if (memcmp(node_records[i].node_id, name, ENV_NODE_NAME_LEN) == 0) {
            return &node_records[i];
        }
    }

    if (node_count < SNIFFER_MAX_NODES) {
        return &node_records[node_count++];
    }

    return NULL;
}

struct parse_ctx {
    struct raw_adv_record *rec;
    bool has_name;
    bool has_data;
    bool is_cmd;
};

static bool parse_sniffer_ad(struct bt_data *data, void *user_data)
{
    struct parse_ctx *ctx = user_data;

    if (data->type == BT_DATA_NAME_COMPLETE ||
        data->type == BT_DATA_NAME_SHORTENED) {

        /* Just use name to confirm it's a sensor node */
        if (data->data_len >= 5 &&
            memcmp(data->data, "node_", 5) == 0) {
            ctx->has_name = true;
        }
        return true;
    }

    if (data->type == BT_DATA_MANUFACTURER_DATA) {

        if (data->data_len < 2) {
            return true;
        }

        uint16_t company_id = sys_get_le16(&data->data[0]);

        if (company_id == COMPANY_ID_CMD) {
            ctx->is_cmd = true;
            return true;
        }

        if (company_id == COMPANY_ID_DATA &&
            data->data_len == MFG_DATA_LEN) {

            /* Build node_id string from origin node ID byte */
            uint8_t origin_id = data->data[2];
            snprintf(ctx->rec->node_id, ENV_NODE_NAME_LEN,
                     "node_%u", origin_id);

            ctx->rec->seq          = data->data[3];
            ctx->rec->temp_centi_c = (int16_t)sys_get_le16(&data->data[4]);
            ctx->rec->hum_centi_rh = sys_get_le16(&data->data[6]);
            ctx->rec->eco2_ppm     = sys_get_le16(&data->data[8]);
            ctx->rec->tvoc_ppb     = sys_get_le16(&data->data[10]);
            ctx->has_data          = true;
        }
    }

    return true;
}

void sniffer_device_found(const bt_addr_le_t *addr, int8_t rssi,
                                  uint8_t type, struct net_buf_simple *ad)
{
    struct raw_adv_record raw = {0};
    struct parse_ctx ctx = { .rec = &raw };

    bt_data_parse(ad, parse_sniffer_ad, &ctx);

    if (ctx.is_cmd || !ctx.has_name || !ctx.has_data) {
        return;
    }

    raw.timestamp_ms = (uint32_t)k_uptime_get();

    if (k_msgq_put(&adv_msgq, &raw, K_NO_WAIT) != 0) {
        LOG_WRN("adv_msgq full, dropping packet from %s", raw.node_id);
    }
}

static void do_broadcast_command(uint8_t cmd)
{
    static uint8_t seq = 0;
    static uint8_t cmd_payload[4];

    for (int i = 0; i < CMD_BROADCAST_COUNT; i++) {
        sys_put_le16(COMPANY_ID_CMD, &cmd_payload[0]);
        cmd_payload[2] = seq++;
        cmd_payload[3] = cmd;

        struct bt_data ad[] = {
            BT_DATA_BYTES(BT_DATA_FLAGS, BT_LE_AD_NO_BREDR),
            BT_DATA(BT_DATA_MANUFACTURER_DATA,
                    cmd_payload, sizeof(cmd_payload)),
        };

        int err = bt_le_adv_start(BT_LE_ADV_NCONN, ad, ARRAY_SIZE(ad),
                                  NULL, 0);
        if (err) {
            printk("Command broadcast failed (err %d)\n", err);
            return;
        }

        k_sleep(K_MSEC(CMD_BROADCAST_DURATION_MS));
        bt_le_adv_stop();
        k_sleep(K_MSEC(CMD_BROADCAST_GAP_MS));
    }

    printk("Command 0x%02X broadcast into mesh (%d times)\n",
           cmd, CMD_BROADCAST_COUNT);
    
    printk("Restarting mobile_node advertisement...\n");

    k_work_reschedule(&adv_restart_work, K_MSEC(100));
}

void ble_broadcast_command(uint8_t cmd)
{
    if (k_msgq_put(&cmd_msgq, &cmd, K_NO_WAIT) != 0) {
        printk("cmd_msgq full, dropping command 0x%02X\n", cmd);
    }
}

K_THREAD_STACK_DEFINE(nus_send_stack, NUS_SEND_THREAD_STACK);
static struct k_thread nus_send_thread_data;

static void nus_send_thread(void *p1, void *p2, void *p3)
{
    ARG_UNUSED(p1);
    ARG_UNUSED(p2);
    ARG_UNUSED(p3);

    while (1) {
        k_sleep(K_MSEC(SNIFF_WINDOW_MS));

        k_mutex_lock(&node_records_mutex, K_FOREVER);

        for (int i = 0; i < node_count; i++) {
            if (current_conn == NULL || !nus_notify_enabled) {
                printk("Cannot send — not connected or notify disabled\n");
                break;
            }

            int ret = bt_nus_send(current_conn,
                                  (uint8_t *)&node_records[i],
                                  sizeof(struct env_record));
            if (ret) {
                printk("NUS send failed for %s (err %d)\n",
                       node_records[i].node_id, ret);
            } else {
                printk("Sent record for %.6s\n",
                       node_records[i].node_id);
            }
        }

        /* Send EOW marker, indicates transmission of node telemetry data is over */
        if (current_conn != NULL && nus_notify_enabled) {
            struct env_record eow = {0};
            memcpy(eow.node_id, EOW_NODE_ID, strlen(EOW_NODE_ID));
            int ret = bt_nus_send(current_conn,
                                  (uint8_t *)&eow,
                                  sizeof(struct env_record));
            if (ret) {
                printk("EOW send failed (err %d)\n", ret);
            } else {
                printk("EOW sent\n");
            }
        }

        memset(node_records, 0, sizeof(node_records));
        node_count = 0;

        k_mutex_unlock(&node_records_mutex);
    }
}

K_THREAD_STACK_DEFINE(proc_stack, PROC_THREAD_STACK);
static struct k_thread proc_thread_data;

static void proc_thread(void *p1, void *p2, void *p3)
{
    ARG_UNUSED(p1);
    ARG_UNUSED(p2);
    ARG_UNUSED(p3);

    struct raw_adv_record raw;
    uint8_t cmd;

    while (1) {
        while (k_msgq_get(&adv_msgq, &raw, K_NO_WAIT) == 0) {

            struct node_seq_entry *seq_entry =
                find_or_alloc_seq(raw.node_id);

            if (!seq_entry) {
                continue;
            }

            if (!seq_is_valid(seq_entry, raw.seq)) {
                continue;
            }

            seq_entry->last_seq     = raw.seq;
            seq_entry->last_seen_ms = raw.timestamp_ms;

            k_mutex_lock(&node_records_mutex, K_FOREVER);
            struct env_record *slot = find_or_alloc_node(raw.node_id);
            if (slot) {
                memcpy(slot->node_id, raw.node_id, ENV_NODE_NAME_LEN);
                slot->timestamp_ms  = raw.timestamp_ms;
                slot->temp_centi_c  = raw.temp_centi_c;
                slot->hum_centi_rh  = raw.hum_centi_rh;
                slot->eco2_ppm      = raw.eco2_ppm;
                slot->tvoc_ppb      = raw.tvoc_ppb;
            }
            k_mutex_unlock(&node_records_mutex);
        }

        while (k_msgq_get(&cmd_msgq, &cmd, K_NO_WAIT) == 0) {
            do_broadcast_command(cmd);
        }

        k_sleep(K_MSEC(10));
    }
}

void sniffer_start(void)
{
    k_mutex_init(&node_records_mutex);
    memset(seq_table, 0, sizeof(seq_table));

    static const struct bt_le_scan_param scan_param = {
        .type     = BT_LE_SCAN_TYPE_ACTIVE,
        .options  = BT_LE_SCAN_OPT_NONE,
        .interval = BT_GAP_SCAN_FAST_INTERVAL,
        .window   = BT_GAP_SCAN_FAST_WINDOW,
    };

    int err = bt_le_scan_start(&scan_param, sniffer_device_found);
    if (err) {
        printk("Sniffer scan start failed (err %d)\n", err);
        return;
    }

    printk("Sniffer started, listening for sensor nodes...\n");

    k_thread_create(&nus_send_thread_data, nus_send_stack,
                    NUS_SEND_THREAD_STACK,
                    nus_send_thread, NULL, NULL, NULL,
                    NUS_SEND_THREAD_PRIORITY, 0, K_NO_WAIT);
    k_thread_name_set(&nus_send_thread_data, "nus_send");

    /* Send environmental data off to base node */
    k_thread_create(&proc_thread_data, proc_stack,
                    PROC_THREAD_STACK,
                    proc_thread, NULL, NULL, NULL,
                    PROC_THREAD_PRIORITY, 0, K_NO_WAIT);
    k_thread_name_set(&proc_thread_data, "proc");
}
```

## src/nus_peripheral.c
```c
/*
 * Black-Valetudo - Mobile Node
 * NUS Peripheral implementation
 */

#include "nus_peripheral.h"
#include "ble.h"

#include <zephyr/kernel.h>
#include <zephyr/logging/log.h>
#include <zephyr/bluetooth/bluetooth.h>
#include <zephyr/bluetooth/conn.h>
#include <zephyr/bluetooth/gatt.h>
#include <zephyr/bluetooth/uuid.h>
#include <zephyr/bluetooth/services/nus.h>
#include <string.h>

LOG_MODULE_REGISTER(nus_peripheral, LOG_LEVEL_INF);

#define CMD_MEASURE 0x01
#define CMD_SLEEP   0x02

struct bt_conn *current_conn;
bool nus_notify_enabled = false;
struct k_work_delayable adv_restart_work;

static const struct bt_data ad[] = {
    BT_DATA_BYTES(BT_DATA_FLAGS,
                  BT_LE_AD_GENERAL | BT_LE_AD_NO_BREDR),
    BT_DATA_BYTES(BT_DATA_UUID128_ALL,
                  BT_UUID_NUS_SRV_VAL),
};

static const struct bt_data sd[] = {
    BT_DATA(BT_DATA_NAME_COMPLETE,
            CONFIG_BT_DEVICE_NAME,
            sizeof(CONFIG_BT_DEVICE_NAME) - 1),
};

static void adv_restart_fn(struct k_work *work)
{
    ARG_UNUSED(work);

    if (current_conn != NULL) {
        printk("Already connected, skipping adv restart\n");
        return;
    }

    printk("adv_restart_fn called\n");

    int err = bt_le_adv_start(BT_LE_ADV_CONN_FAST_2, ad, ARRAY_SIZE(ad),
                              sd, ARRAY_SIZE(sd));
    if (err == -EALREADY) {
        printk("Already advertising\n");
    } else if (err) {
        LOG_ERR("Advertising restart failed (err %d), retrying...", err);
        k_work_reschedule((struct k_work_delayable *)work, K_MSEC(500));
        return;
    } else {
        printk("Advertising as mobile_node...\n");
    }

    /* Restart sniffer scan after advertising is up */
    err = bt_le_scan_start(&(struct bt_le_scan_param){
        .type     = BT_LE_SCAN_TYPE_ACTIVE,
        .options  = BT_LE_SCAN_OPT_NONE,
        .interval = BT_GAP_SCAN_FAST_INTERVAL,
        .window   = BT_GAP_SCAN_FAST_WINDOW,
    }, sniffer_device_found);
    if (err && err != -EALREADY) {
        LOG_ERR("Scan restart failed (err %d)", err);
    } else {
        printk("Sniffer scan restarted\n");
    }
}

static void nus_notif_changed(bool enabled, void *ctx)
{
    ARG_UNUSED(ctx);
    nus_notify_enabled = enabled;
    printk("NUS notify %s\n", enabled ? "enabled" : "disabled");
}

static void on_receive(struct bt_conn *conn,
                       const void *data, uint16_t len,
                       void *ctx)
{
    ARG_UNUSED(ctx);

    const uint8_t *bytes = data;

    if (len < 1) {
        return;
    }

    switch (bytes[0]) {
    case CMD_MEASURE:
        printk("Command received: CMD_MEASURE\n");
        ble_broadcast_command(CMD_MEASURE);
        break;
    case CMD_SLEEP:
        printk("Command received: CMD_SLEEP\n");
        ble_broadcast_command(CMD_SLEEP);
        break;
    default:
        printk("Command received: unknown (0x%02X)\n", bytes[0]);
        break;
    }
}

static struct bt_nus_cb nus_cb = {
    .received      = on_receive,
    .notif_enabled = nus_notif_changed,
};

static void connected(struct bt_conn *conn, uint8_t err)
{
    char addr[BT_ADDR_LE_STR_LEN];

    bt_addr_le_to_str(bt_conn_get_dst(conn), addr, sizeof(addr));

    if (err) {
        LOG_ERR("Connection failed (err %u)", err);
        return;
    }

    current_conn = conn;
    printk("Connected to base_node (%s)\n", addr);
}

static void disconnected(struct bt_conn *conn, uint8_t reason)
{
    char addr[BT_ADDR_LE_STR_LEN];

    bt_addr_le_to_str(bt_conn_get_dst(conn), addr, sizeof(addr));

    printk("Disconnected from base_node (%s) reason 0x%02x\n", addr, reason);

    if (current_conn == conn) {
        current_conn = NULL;
    }

    /* Stop scan to free BLE controller resources before advertising */
    bt_le_scan_stop();

    k_work_reschedule(&adv_restart_work, K_MSEC(1000));
}

BT_CONN_CB_DEFINE(conn_callbacks) = {
    .connected    = connected,
    .disconnected = disconnected,
};

int nus_peripheral_init(void)
{
    int err;

    k_work_init_delayable(&adv_restart_work, adv_restart_fn);

    err = bt_enable(NULL);
    if (err) {
        LOG_ERR("Bluetooth init failed (err %d)", err);
        return err;
    }

    LOG_INF("Bluetooth initialised");

    err = bt_nus_cb_register(&nus_cb, NULL);
    if (err) {
        LOG_ERR("NUS callback register failed (err %d)", err);
        return err;
    }

    err = bt_le_adv_start(BT_LE_ADV_CONN_FAST_2, ad, ARRAY_SIZE(ad),
                          sd, ARRAY_SIZE(sd));
    if (err) {
        LOG_ERR("Advertising failed (err %d)", err);
        return err;
    }

    printk("Advertising as mobile_node...\n");

    return 0;
}
```

## src/watchdog.c
```c
/*
 * Black-Valetudo
 * Watchdog timer implementation
 */

#include "watchdog.h"

#include <zephyr/kernel.h>
#include <zephyr/logging/log.h>
#include <zephyr/drivers/watchdog.h>

LOG_MODULE_REGISTER(watchdog, LOG_LEVEL_INF);

#define WDT_TIMEOUT_MS 30000 

static const struct device *wdt;
static int wdt_channel_id;

static void wdt_callback(const struct device *dev, int channel_id)
{
    LOG_WRN("Watchdog expired — resetting");
}

int watchdog_init(void)
{
    wdt = DEVICE_DT_GET(DT_NODELABEL(wdt0));

    if (!device_is_ready(wdt)) {
        LOG_ERR("Watchdog device not ready");
        return -ENODEV;
    }

    struct wdt_timeout_cfg wdt_cfg = {
        .window = {
            .min = 0,
            .max = WDT_TIMEOUT_MS,
        },
        .callback = wdt_callback,
        .flags    = WDT_FLAG_RESET_SOC,
    };

    wdt_channel_id = wdt_install_timeout(wdt, &wdt_cfg);
    if (wdt_channel_id < 0) {
        LOG_ERR("Watchdog install timeout failed (err %d)", wdt_channel_id);
        return wdt_channel_id;
    }

    int err = wdt_setup(wdt, WDT_OPT_PAUSE_HALTED_BY_DBG);
    if (err) {
        LOG_ERR("Watchdog setup failed (err %d)", err);
        return err;
    }

    LOG_INF("Watchdog initialised (%d ms timeout)", WDT_TIMEOUT_MS);
    return 0;
}

void watchdog_feed(void)
{
    wdt_feed(wdt, wdt_channel_id);
}
```
